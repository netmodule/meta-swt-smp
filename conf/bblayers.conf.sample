## conf/bblayers.conf.sample
```bitbake
# LAYER_CONF_VERSION is increased each time build/conf/bblayers.conf
# changes incompatibly
LCONF_VERSION = "6"

BBPATH = "${TOPDIR}"
BBFILES ?= ""

BBLAYERS ?= " \
  ##COREBASE##/meta \
  ##COREBASE##/meta-yocto \
  ##COREBASE##/meta-yocto-bsp \
  ##COREBASE##/meta-xilinx \
  ##COREBASE##/meta-xilinx-community \
  ##COREBASE##/meta-swt-smp \
  "
BBLAYERS_NON_REMOVABLE ?= " \
  ##COREBASE##/meta \
  ##COREBASE##/meta-yocto \
  "
```

## conf/layer.conf
```bitbake
#@TYPE: Layer
#@NAME: meta-swt-smp
#@DESCRIPTION: NetModule layer for software training on multithread and multicore
#@AUTHOR: David Andrey <david.andrey@netmodule.com>
#@HOMEPAGE = "http://www.netmodule.com" 

# We have a conf and classes directory, add to BBPATH
BBPATH := "${BBPATH}:${LAYERDIR}"

# We have a packages directory, add to BBFILES
BBFILES += "${LAYERDIR}/recipes-*/*/*.bb \
            ${LAYERDIR}/recipes-*/*/*.bbappend"

BBFILE_COLLECTIONS += "swt-smp"
BBFILE_PATTERN_swt-smp := "^${LAYERDIR}/"
BBFILE_PRIORITY_swt-smp = "8"

BB_DANGLINGAPPENDS_WARNONLY ?= "true"
```
